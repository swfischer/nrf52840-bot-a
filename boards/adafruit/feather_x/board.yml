## boards/nordic/nrf52840dk_x/Kconfig.nrf52840dk_x
```kconfig
# Copyright (c) 2022 Zephyr Project members and individual contributors
# SPDX-License-Identifier: Apache-2.0

config BOARD_NRF52840DK_X
	select SOC_NRF52840_QIAA if BOARD_NRF52840DK_X_NRF52840
	select SOC_NRF52811_QFAA if BOARD_NRF52840DK_X_NRF52811
```

## west.yml
```yaml
manifest:
  self:
    path: apps

  remotes:
    - name: zephyr-github
      url-base: https://github.com/zephyrproject-rtos

  projects:
    - name: zephyr
      remote: zephyr-github
      repo-path: zephyr
      # This is nearly 3.7.0, but had a compile error with 3.7.0 so sticking with this for now.
      revision: 38ad4b6d43cfc875a7ce8fdbe96825aa3e86ce6d
      import: true
```
