## CMakeLists.txt
```
# SPDX-License-Identifier: Apache-2.0

cmake_minimum_required(VERSION 3.20.0)

if (NOT build)
    set(build zephyr)
endif()

if (build STREQUAL zephyr)
    # Re-direct the directory where the 'boards' directory is found from $ZEPHYR_BASE to this directory.
    list(APPEND BOARD_ROOT ${CMAKE_CURRENT_SOURCE_DIR}/..)

    if (NOT BOARD)
        # Set default board
        set(BOARD nrf52840dk_x/nrf52840)
    endif()

    find_package(Zephyr REQUIRED HINTS $ENV{ZEPHYR_BASE})
endif()

project(lidar-test)

set(CMAKE_C_FLAGS "${CMAKE_C_FLAGS} -Werror -Wall -std=c99")

list(APPEND COMMON_INCLUDES src)
list(APPEND COMMON_INCLUDES src/app)
list(APPEND COMMON_INCLUDES src/hw)
list(APPEND COMMON_INCLUDES src/svcs)

list(APPEND COMMON_SOURCES src/main.c)
list(APPEND COMMON_SOURCES src/app/drive_ctrl.c)
list(APPEND COMMON_SOURCES src/app/lidar.c)
list(APPEND COMMON_SOURCES src/app/mapper.c)
list(APPEND COMMON_SOURCES src/app/mapper_shell.c)
list(APPEND COMMON_SOURCES src/app/panner.c)
list(APPEND COMMON_SOURCES src/app/panner_shell.c)
list(APPEND COMMON_SOURCES src/app/roamer_app.c)
list(APPEND COMMON_SOURCES src/app/tracks.c)
list(APPEND COMMON_SOURCES src/app/tracks_shell.c)
list(APPEND COMMON_SOURCES src/hw/dcme.c)
list(APPEND COMMON_SOURCES src/hw/drivetrain.c)
list(APPEND COMMON_SOURCES src/hw/drivetrain_shell.c)
list(APPEND COMMON_SOURCES src/hw/i2c_al_zephyr.c)
list(APPEND COMMON_SOURCES src/hw/imu_al_zephyr_ism330dhcx.c)
list(APPEND COMMON_SOURCES src/hw/imu_al_shell.c)
list(APPEND COMMON_SOURCES src/hw/lx16a.c)
list(APPEND COMMON_SOURCES src/hw/lx16a_shell.c)
list(APPEND COMMON_SOURCES src/hw/pid.c)
list(APPEND COMMON_SOURCES src/hw/rgb_led_neopixel.c)
list(APPEND COMMON_SOURCES src/hw/rgb_led_shell.c)
list(APPEND COMMON_SOURCES src/hw/sign_of_life.c)
list(APPEND COMMON_SOURCES src/hw/start_stop.c)
list(APPEND COMMON_SOURCES src/hw/tfluna.c)
list(APPEND COMMON_SOURCES src/hw/tfluna_shell.c)
list(APPEND COMMON_SOURCES src/hw/uart_al_zephyr.c)
list(APPEND COMMON_SOURCES src/svcs/os_al.c)
list(APPEND COMMON_SOURCES src/svcs/os_al_timer.c)
list(APPEND COMMON_SOURCES src/svcs/shutdown_shell.c)

if(build STREQUAL zephyr)
    add_compile_definitions(ZEPHYR_BUILD)
    target_include_directories(app PRIVATE ${COMMON_INCLUDES})
    target_sources(app PRIVATE ${COMMON_SOURCES})
endif()
```

## prj.conf
```kconfig
# Basic configs needed
CONFIG_NEWLIB_LIBC=y
CONFIG_POSIX_API=y
CONFIG_MAX_PTHREAD_COUNT=10
CONFIG_MAX_PTHREAD_COND_COUNT=10
CONFIG_MAX_PTHREAD_MUTEX_COUNT=15
# Enable the shell
CONFIG_SHELL=y
CONFIG_SHELL_STACK_SIZE=4096
# Enable uart console, but serial is also for the servo interface
CONFIG_SERIAL=y
CONFIG_CONSOLE=y
CONFIG_UART_CONSOLE=y
CONFIG_HWINFO=y
CONFIG_REBOOT=y
# Enable logging
CONFIG_LOG=y
CONFIG_LOG_CMDS=y
CONFIG_LOG_MODE_DEFERRED=y
CONFIG_LOG_BUFFER_SIZE=2048
CONFIG_LOG_PRINTK=y
CONFIG_LOG_PROCESS_TRIGGER_THRESHOLD=0
CONFIG_LOG_TAG_MAX_LEN=8
CONFIG_LOG_FUNC_NAME_PREFIX_ERR=y
CONFIG_LOG_FUNC_NAME_PREFIX_WRN=y
CONFIG_LOG_FUNC_NAME_PREFIX_INF=y
CONFIG_LOG_FUNC_NAME_PREFIX_DBG=y
# For Neopixel support
CONFIG_SPI=y
CONFIG_LED_STRIP=y
CONFIG_LED_STRIP_LOG_LEVEL_DBG=y
# For IMS330DHCX Accel/Gyro support
CONFIG_SENSOR=y
CONFIG_SENSOR_LOG_LEVEL_DBG=y
CONFIG_ISM330DHCX_TRIGGER_NONE=y
# For basic interactions
CONFIG_GPIO=y
CONFIG_I2C=y
CONFIG_PWM=y
```

## src/main.c
```c
/*****************************************************************************
 * main.c - the main function for this application
 *****************************************************************************/

#include <unistd.h>

#include "logger.h"
#include "roamer_app.h"
#include "sign_of_life.h"

LOG_MODULE_REGISTER(APP_MODULE_LOGGER_NAME, APP_MODULE_LOGGER_LEVEL);

int main(void)
{
	LOG_INF("Starting Bot-A application");

	if (roamer_app_start() != 0) {
		LOG_ERR("App start failed");
	} else {
		LOG_DBG("App start success");
	}

	// Continue to use this task as SOL indicator
	// Note, this call does not return unless sign_of_life_end() is called
	sign_of_life_start();

	roamer_app_exit();

	// Spin in a loop forever, just to be sure what the system is doing
	while (1) {
		sleep(5);
	}

	return 0;
}
```
